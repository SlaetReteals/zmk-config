## config/west.yml
```yaml
manifest:
  self:
    path: config
  remotes:
    - name: zmkfirmware
      url-base: https://github.com/zmkfirmware
    - name: slaetreteals
      url-base: https://github.com/SlaetReteals

    - name: badjeff
      url-base: https://github.com/badjeff

  projects:
    - name: zmk
      remote: zmkfirmware
      revision: main
      import: app/west.yml
      
    - name: zmk-keyboards
      remote: slaetjoystick
      revision: main
      
    - name: zmk-analog-input-driver
      remote: badjeff
      revision: main

    - name: zmk-hid-io
      remote: badjeff
      revision: main
```
